## openvela_app/smart_band/Kconfig
```kconfig
config LVX_USE_DEMO_SMART_BAND_BASIC
	bool "Smart band basic LVGL demo"
	depends on GRAPHICS_LVGL && LV_USE_NUTTX && LV_USE_NUTTX_LIBUV
	default n
	---help---
		Enable the basic smart band demo application. It follows the
		packages/demos style used by openvela native demos such as Bandx.
		The demo shows a watch face, health metrics, and swipe navigation.

if LVX_USE_DEMO_SMART_BAND_BASIC

config LVX_DEMO_SMART_BAND_BASIC_PRIORITY
	int "Smart band basic task priority"
	default 100

config LVX_DEMO_SMART_BAND_BASIC_STACKSIZE
	int "Smart band basic stack size"
	default 32768

config LVX_DEMO_SMART_BAND_USE_SENSORS
	bool "Use uORB and battery sensor providers"
	depends on SENSORS && UORB
	default y
	---help---
		Read real sensor samples when the required openvela sensor and uORB
		subsystems are enabled. If disabled, sensor_bridge.c builds as a
		no-op provider and the watch model uses explicit simulation mode.

config LVX_DEMO_SMART_BAND_STORAGE_PATH
	string "Smart band persistent storage directory"
	default ""
	---help---
		Existing writable directory used by the versioned A/B storage
		backend. An empty value keeps the explicit no-op backend. The
		application never creates or guesses a board partition path.

endif
```
